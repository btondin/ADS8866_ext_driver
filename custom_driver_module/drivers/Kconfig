## custom_driver_module/drivers/Kconfig
```kconfig
# custom_driver_module/drivers/Kconfig

menu "Drivers"
# Carrega o arquivo Kconfig do nosso driver
rsource "custom_ADS8866/Kconfig.ads8866"
endmenu
```

## custom_driver_module/drivers/custom_ADS8866/Kconfig.ads8866
```kconfig
config ADC_ADS8866
    bool "Custom ADS8866 sensor"
    default y
    depends on DT_HAS_TI_CUSTOM_ADS8866_ENABLED
    select SPI
    select ADC_CONFIGURABLE_INPUTS
    help
      Enable custom ADS8866 driver



if ADC_ADS8866

config ADC_ADS8866_INIT_PRIORITY
	int "ADS7052 init priority"
	default 80
	help
	  ADS7052 device initialization priority must come
	  after SPI initialization

config ADC_ADS8866_ACQUISITION_THREAD_STACK_SIZE
	int "Stack size for the ADC data acquisition thread"
	default 1024
	help
	  Size of the stack used for the internal data acquisition
	  thread.

config ADC_ADS8866_ACQUISITION_THREAD_PRIO
	int "Priority for the ADC data acquisition thread"
	default 0
	help
	  Priority level for the internal ADC data acquisition thread.

endif # ADC_ADS8866
```
